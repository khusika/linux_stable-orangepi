// SPDX-License-Identifier: (GPL-2.0+ OR MIT)
/*
 * Copyright (c) 2025 Rockchip Electronics Co., Ltd.
 */

/dts-v1/;
#include "rv1126b.dtsi"
#include "rv1126b-evb.dtsi"

/ {
	model = "Rockchip RV1126B-P EVB V14 Board";
	compatible = "rockchip,rv1126bp-evb-v14", "rockchip,rv1126b";
};


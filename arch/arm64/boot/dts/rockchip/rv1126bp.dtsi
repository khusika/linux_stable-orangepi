// SPDX-License-Identifier: (GPL-2.0+ OR MIT)
/*
 * Copyright (c) 2025 Rockchip Electronics Co., Ltd.
 */

#include "rv1126b.dtsi"

/ {
};

&usb_drd_dwc3 {
	phys = <&usb2phy_otg>;
	phy-names = "usb2-phy";
	maximum-speed = "high-speed";
	snps,dis_u2_susphy_quirk;
	snps,usb2-lpm-disable;
	snps,usb2-gadget-lpm-disable;
};
